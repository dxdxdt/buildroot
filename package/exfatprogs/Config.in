## package/exfatprogs/Config.in
```kconfig
config BR2_PACKAGE_EXFATPROGS
	bool "exfatprogs"
	depends on BR2_USE_WCHAR
	depends on BR2_USE_MMU # util-linux/libblkid
	select BR2_PACKAGE_UTIL_LINUX
	select BR2_PACKAGE_UTIL_LINUX_LIBBLKID
	select BR2_PACKAGE_MUSL_FTS if !BR2_TOOLCHAIN_USES_GLIBC
	help
	  exFAT filesystem userspace utilities.

	  This is the set of tools that works together with the exfat
	  driver in the official Linux kernel (merged in Linux 5.7).

	  If you're using the FUSE-based exfat support (from
	  package/exfat), you must use the corresponding user-space
	  programs in package/exfat-utils.

	  https://github.com/exfatprogs/exfatprogs

comment "exfatprogs needs a toolchain w/ wchar"
	depends on !BR2_USE_WCHAR
```
